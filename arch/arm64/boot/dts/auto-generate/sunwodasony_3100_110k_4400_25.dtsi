/* DO NOT EDIT - Automatically generated by python */
/ {
		sunwodasony_3100_110k_4400_25:sunwodasony_3100_110k_4400_25 {
			fcc = <3100>;
			default_rbatt_mohm = <100>;
			id_identify_min = <2281>;
			id_identify_max = <2786>;
			id_voltage_min = <2426>;
			id_voltage_max = <2631>;
			vbat_max = <4400>;
			temp_para = 
						"-32767","0","-1","0","4100","0",
						"0","5","-1","310","4400","0",
						"5","10","-1","930","4400","3",
						"10","45","-1","-1","4400","3",
						"45","50","-1","1085","4400","3",
						"50","32767","-1","0","4400","0";
			vbat_para = 
						"-32767","3400","-1","820","0",
						"3400","32767","-1","-1","0";
			segment_para = 
						"-32767","4150","3100","4208","50",
						"4150","4450","2170","4400","0";
			batt_brand = "sunwodasony";
			fcc_temp = <3092 3099 3109 3167 3130 3111>;
			fcc_sf_x = <0 100 200 300 400 500>;
			fcc_sf_y = <100 96 94 92 90 88>;
			fcc_sf_cols = <6>;
			pc_sf_rows = <1>;
			pc_sf_cols = <1>;
			pc_sf_row_entries = <0>;
			pc_sf_percent = <100>;
			pc_sf_sf = <100>;
			rbatt_sf_rows = <28>;
			rbatt_sf_cols = <6>;
			rbatt_sf_percent = <100 95 90 85 80 75 70 65 60 55 50 45 40 35 30 25 20 15 10 9 8 7 6 5 4 3 2 1>;
			rbatt_sf_sf = <
			               1707 835 422 162 121 109
			               1705 840 426 163 121 109
			               1692 853 437 165 123 110
			               1672 867 447 169 126 111
			               1663 877 465 175 129 112
			               1603 877 481 182 133 114
			               1563 855 470 193 140 118
			               1566 853 456 199 148 123
			               1573 857 447 184 142 122
			               1580 863 441 166 127 112
			               1618 878 444 161 123 110
			               1676 919 450 164 125 110
			               1746 984 465 170 128 112
			               1837 1061 492 176 133 115
			               1951 1146 533 176 131 114
			               2102 1263 581 170 126 110
			               2327 1434 644 171 128 112
			               2863 1733 768 175 128 112
			               5052 1965 711 169 127 114
			               6165 2267 748 173 128 114
			               7491 2634 809 177 130 115
			               9201 3185 907 183 131 117
			               11634 3930 1028 185 132 118
			               16585 5126 1236 189 132 118
			               29006 6674 1541 202 136 116
			               50130 9245 1989 253 141 118
			               84365 17537 2815 355 210 149
			               136508 35614 4728 515 199 220
			              >;
			pc_temp_ocv_rows = <29>;
			pc_temp_ocv_cols = <6>;
			pc_temp_ocv_percent = <100 95 90 85 80 75 70 65 60 55 50 45 40 35 30 25 20 15 10 9 8 7 6 5 4 3 2 1>;
			pc_temp_ocv_ocv = <
			                   4356 4355 4353 4354 4339 4334
			                   4266 4280 4283 4289 4275 4270
			                   4195 4215 4221 4229 4217 4212
			                   4133 4156 4161 4170 4159 4155
			                   4081 4100 4106 4114 4104 4100
			                   4017 4043 4054 4061 4053 4049
			                   3955 3983 3999 4012 4006 4003
			                   3908 3931 3947 3966 3963 3961
			                   3867 3888 3902 3917 3916 3916
			                   3829 3849 3863 3875 3873 3872
			                   3801 3816 3831 3843 3842 3840
			                   3777 3791 3805 3819 3818 3816
			                   3756 3774 3785 3799 3800 3797
			                   3737 3759 3770 3783 3784 3780
			                   3720 3743 3756 3767 3764 3757
			                   3702 3725 3741 3746 3741 3729
			                   3682 3700 3718 3725 3719 3707
			                   3656 3668 3683 3695 3690 3679
			                   3616 3627 3642 3664 3660 3650
			                   3603 3617 3635 3659 3656 3646
			                   3587 3605 3628 3653 3650 3641
			                   3567 3592 3620 3645 3643 3634
			                   3547 3575 3607 3633 3632 3621
			                   3522 3557 3588 3608 3606 3595
			                   3490 3525 3556 3565 3564 3555
			                   3446 3471 3503 3512 3511 3503
			                   3397 3400 3429 3446 3445 3437
			                   3303 3313 3332 3358 3350 3349
			                   3200 3200 3200 3200 3200 3200
			                  >;
		};
};
