/* DO NOT EDIT - Automatically generated by python */
/ {
		scudatl_3100_68k_4400_25:scudatl_3100_68k_4400_25 {
			fcc = <3100>;
			default_rbatt_mohm = <100>;
			id_identify_min = <1759>;
			id_identify_max = <2281>;
			id_voltage_min = <1956>;
			id_voltage_max = <2135>;
			vbat_max = <4400>;
			temp_para = 
						"-32767","0","-1","0","4100","0",
						"0","5","-1","310","4400","0",
						"5","10","-1","930","4400","3",
						"10","45","-1","-1","4400","3",
						"45","50","-1","1085","4400","3",
						"50","32767","-1","0","4400","0";
			vbat_para = 
						"-32767","3400","-1","820","0",
						"3400","32767","-1","-1","0";
			segment_para = 
						"-32767","4150","3100","4208","50",
						"4150","4450","2170","4400","0";
			batt_brand = "scudatl";
			fcc_temp = <3085 3126 3072 3088 3058 3033>;
			fcc_sf_x = <0 100 200 300 400 500>;
			fcc_sf_y = <100 96 94 92 90 88>;
			fcc_sf_cols = <6>;
			pc_sf_rows = <1>;
			pc_sf_cols = <1>;
			pc_sf_row_entries = <0>;
			pc_sf_percent = <100>;
			pc_sf_sf = <100>;
			rbatt_sf_rows = <28>;
			rbatt_sf_cols = <6>;
			rbatt_sf_percent = <100 95 90 85 80 75 70 65 60 55 50 45 40 35 30 25 20 15 10 9 8 7 6 5 4 3 2 1>;
			rbatt_sf_sf = <
			               2129 1316 738 151 110 97
			               2080 1301 736 151 110 97
			               1888 1242 724 150 111 97
			               1766 1178 704 151 113 98
			               1697 1147 702 153 115 100
			               1610 1121 716 160 118 103
			               1516 1031 672 171 124 106
			               1505 991 663 186 133 111
			               1496 977 617 179 135 113
			               1502 971 595 146 115 99
			               1535 980 594 140 108 97
			               1579 1018 614 141 110 98
			               1642 1074 663 145 114 102
			               1721 1148 729 150 118 105
			               1825 1242 824 150 118 107
			               1931 1350 941 146 110 99
			               2055 1461 1072 146 109 100
			               2212 1574 1220 152 111 99
			               3441 1909 968 151 114 101
			               3842 2085 1047 151 114 104
			               4267 2297 1146 151 115 105
			               4681 2546 1321 153 114 105
			               5088 2808 1499 159 116 104
			               5592 3090 1720 160 115 101
			               6138 3388 1983 167 112 100
			               6752 3756 2273 171 117 104
			               7647 4236 2709 192 121 107
			               8845 4951 3321 376 142 110
			              >;
			pc_temp_ocv_rows = <29>;
			pc_temp_ocv_cols = <6>;
			pc_temp_ocv_percent = <100 95 90 85 80 75 70 65 60 55 50 45 40 35 30 25 20 15 10 9 8 7 6 5 4 3 2 1>;
			pc_temp_ocv_ocv = <
			                   4360 4375 4354 4354 4341 4334
			                   4263 4289 4274 4293 4281 4275
			                   4189 4220 4209 4235 4224 4218
			                   4130 4158 4149 4179 4168 4163
			                   4078 4105 4095 4124 4114 4110
			                   4015 4053 4047 4073 4064 4060
			                   3948 3985 3987 4024 4017 4013
			                   3906 3931 3942 3978 3974 3971
			                   3868 3889 3892 3930 3928 3927
			                   3838 3853 3852 3881 3879 3877
			                   3818 3826 3823 3848 3846 3845
			                   3803 3809 3803 3823 3823 3821
			                   3789 3796 3793 3803 3804 3802
			                   3775 3784 3784 3787 3787 3785
			                   3763 3772 3774 3772 3770 3766
			                   3748 3757 3763 3755 3748 3736
			                   3733 3738 3743 3735 3727 3715
			                   3718 3715 3715 3708 3703 3691
			                   3696 3690 3683 3686 3680 3668
			                   3688 3685 3680 3685 3679 3667
			                   3681 3679 3676 3682 3677 3666
			                   3674 3674 3672 3679 3674 3663
			                   3661 3667 3665 3672 3669 3656
			                   3645 3654 3650 3651 3652 3636
			                   3617 3627 3621 3608 3614 3599
			                   3571 3580 3570 3552 3562 3549
			                   3506 3511 3500 3476 3493 3483
			                   3406 3408 3396 3364 3391 3387
			                   3200 3200 3200 3200 3200 3200
			                  >;
		};
};
